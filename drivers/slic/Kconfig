## drivers/slic/Kconfig
```kconfig
#
# SLIC driver configuration
#


config SLIC
	bool "slic driver"
	help
	      slic driver
```

## drivers/vsim/Kconfig
```kconfig
#
# vsim configuration
#

comment "read vsim data"

config VSIM_SUPPORT
    tristate "read vsim ddr data"
    default y
    help
        read vsim ddr data
```
